## drivers/input/touchscreen/HX852xES/Kconfig
```kconfig
#//hebiao@wind-mobi.com 20180114 begin
# Himax Touchscreen driver configuration
#
config TOUCHSCREEN_HX852xES
        bool "HIMAX Touchscreen"

		default n
		help
		  Say Y here if you have Focaltech touch panel.
		  If unsure, say N.

config TOUCHSCREEN_HIMAX_I2C
        tristate "HIMAX chipset i2c touchscreen"
        default y
		help
		This enables support for HIMAX CHIPSET over I2C based touchscreens.

config TOUCHSCREEN_HIMAX_DEBUG
        tristate "HIMAX debug function"
		depends on TOUCHSCREEN_HIMAX_I2C
		help
		This enables support for HIMAX debug function.

config TOUCHSCREEN_HIMAX_ITO_TEST
	tristate "HIMAX driver test over Dragon Board"
	depends on TOUCHSCREEN_HIMAX_I2C
	help
	  This enables support for HIMAX driver test over Dragon Board.

config HMX_DB
	tristate "HIMAX driver test over Dragon Board"
	depends on TOUCHSCREEN_HIMAX_I2C
	help
	  This enables support for HIMAX driver test over Dragon Board.
#//hebiao@wind-mobi.com 20180114 end
```
